## nuttx-src/apps/examples/lepton/Kconfig
```kconfig
#
# For a description of the syntax of this configuration file,
# see the file kconfig-language.txt in the NuttX tools repository.
#


config EXAMPLES_LEPTON
	tristate "LEPTON example"
	default n
	depends on CAMERA_LEPTON
	---help---
		Enable the LEPTON example

if EXAMPLES_LEPTON

config EXAMPLES_LEPTON_DEVPATH
	string "LEPTON device path"
	default "/dev/lepton" if CAMERA_LEPTON

config EXAMPLES_LEPTON_PROGNAME
	string "LEPTON program name"
	default "lepton"
	---help---
		This is the name of the program that will be used when the NSH ELF
		program is installed.

config EXAMPLES_LEPTON_PRIORITY
	int "LEPTON task priority"
	default 100

config EXAMPLES_LEPTON_STACKSIZE
	int "LEPTON stack size"
	default DEFAULT_TASK_STACKSIZE

endif
```

## nuttx-src/apps/examples/thermal_camera/Kconfig
```kconfig
#
# For a description of the syntax of this configuration file,
# see the file kconfig-language.txt in the NuttX tools repository.
#


config EXAMPLES_THERMAL_CAMERA
	tristate "Thermal camera example"
	default n
	depends on CAMERA_LEPTON || LCD_FT80X_SPI || USBDEV
	---help---
		Enable the THERMAL CAMERA example

if EXAMPLES_THERMAL_CAMERA

config EXAMPLES_LEPTON_DEGREES_UNIT
	bool "Temperature unit in degrees"
	depends on CAMERA_LEPTON
	default y
	
config EXAMPLES_LEPTON_DEVPATH
	string "LEPTON device path"
	depends on CAMERA_LEPTON
	default "/dev/lepton" if CAMERA_LEPTON

config EXAMPLES_FT80X_DEVPATH
	string "FT80x device path"
	depends on LCD_FT80X_SPI
	default "/dev/ft800" if LCD_FT800
	default "/dev/ft801" if LCD_FT801

config EXAMPLES_FT80X_PRIMITIVES
	bool "Enable primitive examples"
	depends on LCD_FT80X_SPI
	default n
	---help---
		Enable some low level tests of GPU primitives.  Not very interesting
		for the most part.

config EXAMPLES_FT80X_EXCLUDE_BITMAPS
	bool "Exclude bitmaps"
	depends on LCD_FT80X_SPI
	default n
	---help---
		On some very minimal platforms, you might want to exclude bitmaps
		which will require 10 s of kilobytes of memory (probably FLASH
		memory, depending on the CPU and the linker script.)

config EXAMPLES_USBDEV_INSTANCE
	int "USB device instance"
	depends on USBDEV
	default 8

config EXAMPLES_THERMAL_CAMERA_PROGNAME
	string "Thermal camera program name"
	default "thermal_camera"
	---help---
		This is the name of the program that will be used when the NSH ELF
		program is installed.

config EXAMPLES_THERMAL_CAMERA_PRIORITY
	int "Thermal camera task priority"
	default 100

config EXAMPLES_THERMAL_CAMERA_STACKSIZE
	int "Thermal camera stack size"
	default DEFAULT_TASK_STACKSIZE

endif
```

## nuttx-src/nuttx/boards/arm/stm32h7/stm32h743vit6-ct2022/Kconfig
```kconfig
#
# For a description of the syntax of this configuration file,
# see the file kconfig-language.txt in the NuttX tools repository.
#

if ARCH_BOARD_STM32H743VIT6_CT2022


if LCD_FT80X_SPI

config STM32H7_FT80X_INITFREQUENCY
	int "FT80x initialization frequency"
	default 400000
	range 400000 11000000

config STM32H7_FT80X_OPFREQUENCY
	int "FT80x operational frequency"
	default 20000000
	range 400000 30000000

endif # LCD_FT80X_SPI && (STM32_SPI1 || STM32_SPI2)

endif # ARCH_BOARD_STM32H743VIT6_CT2022
```

## nuttx-src/nuttx/boards/arm/stm32h7/stm32h747i-disco/Kconfig
```kconfig
#
# For a description of the syntax of this configuration file,
# see the file kconfig-language.txt in the NuttX tools repository.
#

if ARCH_BOARD_STM32H747I_DISCO


if LCD_FT80X_SPI && ((STM32H7_SPI1 && !STM32H7_SPI1_REMAP) || STM32H7_SPI2)

choice
	prompt "FT80x SPI Selection"
	default STM32H7_FT80X_SPI1 if STM32H7_SPI1 && !STM32H7_SPI1_REMAP
	default STM32H7_FT80X_SPI2 if STM32H7_SPI2 && (!STM32H7_SPI1 || STM32H7_SPI1_REMAP)

config STM32H7_FT80X_SPI1
	bool "FT80x on SPI1"
	depends on STM32H7_SPI1 && !STM32H7_SPI1_REMAP

config STM32H7_FT80X_SPI2
	bool "FT80x on SPI2"
	depends on STM32H7_SPI2

endchoice # FT80x SPI Selection

config STM32H7_FT80X_INITFREQUENCY
	int "FT80x initialization frequency"
	default 400000
	range 400000 11000000

config STM32H7_FT80X_OPFREQUENCY
	int "FT80x operational frequency"
	default 20000000
	range 400000 30000000

endif # LCD_FT80X_SPI && ((STM32_SPI1 && !STM32_SPI1_REMAP) || STM32_SPI2)

endif # ARCH_BOARD_STM32H747I_DISCO
```

## nuttx-src/nuttx/drivers/camera/Kconfig
```kconfig
#
# For a description of the syntax of this configuration file,
# see the file kconfig-language.txt in the NuttX tools repository.
#

menu "Camera Driver Support"

menuconfig CAMERA
	bool "Camera Driver Support"
	default n
	---help---
		#TODO

if CAMERA 

	config CAMERA_LEPTON
		bool "LEPTON 2.5 camera module"
		default n

	if CAMERA_LEPTON
		
		config LEPTON_SPI_FREQUENCY
			int "SPI frequency"
			default 4000000
			---help---
			LEPTON SPI frequency

		config LEPTON_I2C_FREQUENCY
			int "I2C frequency"
			default 100000
			range 1 400000
			---help---
			LEPTON I2C frequency

	endif # CAMERA_LEPTON
endif # CAMERA

endmenu # CAMERA
```
